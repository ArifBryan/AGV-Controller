#include <Arduino.h>

#define RFID_TAG_COUNT  16

uint8_t tagLUT[RFID_TAG_COUNT][7] = {
    {0x4A, 0x8A, 0x85, 0xC6},
    {0x5A, 0x33, 0x96, 0xC6},
    {0x5A, 0x62, 0x93, 0xC6},
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    {0xED, 0x94, 0x4C, 0x2B}
};

bool Tag_Compare(uint8_t uid1[4], uint8_t uid2[4]){
    bool res = 1;

    for(uint8_t i = 0; i < 4; i ++){
        res &= uid1[i] == uid2[i];
    }

    return res;
}

uint8_t Tag_Lookup(uint8_t uid[4]){
    uint8_t idx = 0;

    for(uint8_t i = 0; i < RFID_TAG_COUNT; i ++){
        if(Tag_Compare(uid, tagLUT[i])){
            idx = i + 1;
            break;
        }
    }

    return idx;
}
